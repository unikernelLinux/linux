## Kconfig
```kconfig
# SPDX-License-Identifier: GPL-2.0
#
# For a description of the syntax of this configuration file,
# see Documentation/kbuild/kconfig-language.rst.
#
mainmenu "Linux/$(ARCH) $(KERNELVERSION) Kernel Configuration"

source "scripts/Kconfig.include"

source "init/Kconfig"

source "kernel/Kconfig.freezer"

source "fs/Kconfig.binfmt"

source "mm/Kconfig"

source "net/Kconfig"

source "drivers/Kconfig"

source "fs/Kconfig"

source "security/Kconfig"

source "crypto/Kconfig"

source "lib/Kconfig"

source "lib/Kconfig.debug"

source "Documentation/Kconfig"

config UNIKERNEL_LINUX
       bool "Unikernel Linux"
       def_bool y
       help
        Turn on UKL mode

config UKL_SAME_STACK
	bool "UKL Same Stack"
	depends on UNIKERNEL_LINUX
	help
 	Use user stack when switching to kernel code i.e., dont switch to kernel stack when entering the kernel

config UKL_USE_RET
        bool "UKL user ret instead of iret"
        depends on UNIKERNEL_LINUX
        help 
        Use ret instead of iret when returning from kernel after interrupts and faults

config UKL_USE_IST_PF
       bool "UKL use IST for PF instead of DF"
       depends on UNIKERNEL_LINUX
       help 
        Choose this option so that all PFs are handled on a special exception stack from IST. 
        If this option is not chosen, PFs are not handled specially. Only the case where, due 
        to lack of stack, PFs turn into double faults, handle it specially on a double fault stack.

config UKL_CREATE_AFTERSPACE
        bool "UKL create an afterspace to run after UKL finishes"
        depends on UNIKERNEL_LINUX
        help
        You can kill init before ukl runs and then create an afterspace to get results etc out.
```

## kernel/Kconfig.ukl
```kconfig
menuconfig UNIKERNEL_LINUX
	bool "Unikernel Linux"
	depends on X86_64 && !RANDOMIZE_BASE && !PAGE_TABLE_ISOLATION
	help
	    Unikernel Linux allows for a single, privileged process to be
	    linked with the kernel binary and be executed inplace of or
	    along side a more traditional user space.

	    If you don't know what this is, say N.

config UKL_TLS
	bool "Enable TLS for UKL application"
	depends on UNIKERNEL_LINUX
	default Y
	help
	    Not all applications will make use of thread local storage,
	    but we need to account for it in the linker script if used.
	    For the application in samples/ this should be disabled, but
	    if you are working with glibc this should be 'Y'.

	    If unsure say 'Y' here

config UKL_NAME
	string "UKL Exec target"
	depends on UNIKERNEL_LINUX
	default "/data/UKL"
	help
	    We need a way to trigger the start of the UKL application,
	    either by the kernel inplace of init or userspace when setup
	    is finished. The value given here is compared against the
	    filename passed to exec and if they match UKL is started.
	    For a more 'traditional' unikernel model, the value set here
	    should be given to the init= boot parameter.

config UKL_USE_RET
	bool "UKL use RET instead of IRET"
	depends on UNIKERNEL_LINUX
	help
	    Use a RET instruction to return to the UKL user code after a fault
	    or an interrupt.

config UKL_DEEP_SHORTCUT
	bool "Enable the UKL deep shortcutting library"
	depends on UNIKERNEL_LINUX && INET
	help
	    The UKL deep shortcutting library adds glue code for calling deep
	    into kernel subsystems, skipping kernel polymorphism. We have
	    implemented functions to call TCP send and receive using the same
	    arguments as write and read from userspace (our funcitons simply
	    do the transformations needed) but others could be added.
```
